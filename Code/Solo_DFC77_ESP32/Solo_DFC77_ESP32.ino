/*
  Based on this sketch: https://github.com/SensorsIot/DCF77-Transmitter-for-ESP32
  from Andreas Spiess (the guy with the swiss accent :)

  Modified for my custom Solo DCF77 PCB using ESP32 and SPI OLED display.

  22.03.2021 Antonio Velkov
*/


#include <WiFi.h>
#include <Ticker.h>
#include <Time.h>
#include <Wire.h>  // Only needed for Arduino 1.6.5 and earlier
#include <Adafruit_GFX.h>
#include <Adafruit_SSD1306.h>

//OLED config
#define SCREEN_WIDTH 128 // OLED display width, in pixels
#define SCREEN_HEIGHT 64 // OLED display height, in pixels

#define OLED_MOSI   23
#define OLED_CLK   18
#define OLED_DC    17
#define OLED_CS    5
#define OLED_RESET 16

Adafruit_SSD1306 display(SCREEN_WIDTH, SCREEN_HEIGHT,OLED_MOSI, OLED_CLK, OLED_DC, OLED_RESET, OLED_CS);

// Wifi credentials
const char* ssid = "yourSSID";
const char* password = "yourPassword";
                          
#define LEDBUILTIN 26
#define ANTENNAPIN 25

Ticker tickerDecisec; // TBD at 100ms

//complete array of pulses for a minute
//0 = no pulse, 1=100ms, 2=200ms

int impulseArray[60];
int impulseCount = 0;
int actualHours, actualMinutes, actualSecond, actualDay, actualMonth, actualYear, DayOfW;
int timeRunningContinuous = 0;

const char* ntpServer = "bg.pool.ntp.org"; // enter your closest pool or pool.ntp.org
const char* TZ_INFO    = "CET-1CEST-2,M3.5.0/02:00:00,M10.5.0/03:00:00";  // enter your time zone (https://remotemonitoringsystems.ca/time-zone-abbreviations.php)


struct tm timeinfo;

String time_data;
int screensaver = 0;

//Casio Wave Ceptor custom logo
static const unsigned char PROGMEM logo_bmp[] =
{
  0x00, 0x00, 0x00, 0x00, 0x00, 0x00, 0x01, 0x80, 0x00, 0x00, 0x00, 0x00, 0x00, 0x00, 0x00, 0x00, 
  0x00, 0x00, 0x00, 0x00, 0x00, 0x00, 0x00, 0x80, 0x00, 0x00, 0x00, 0x00, 0x00, 0x00, 0x00, 0x00, 
  0x00, 0x00, 0x00, 0x00, 0x00, 0x00, 0x00, 0x80, 0x00, 0x00, 0x00, 0x00, 0x00, 0x00, 0x00, 0x00, 
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  0x00, 0x00, 0x00, 0x00, 0x00, 0x00, 0x00, 0x00, 0x00, 0x00, 0x06, 0x00, 0x00, 0x00, 0x00, 0x00
};

void setup() {
  esp_sleep_disable_wakeup_source(ESP_SLEEP_WAKEUP_ALL);

  Serial.begin(115200);
  Serial.println();
  Serial.println("DCF77 transmitter");
  display.begin(SSD1306_SWITCHCAPVCC);
  display.clearDisplay();
  display.setTextSize(1);
  display.setTextColor(SSD1306_WHITE);
  display.setRotation(2);
  display.setCursor(0, 0);
  display.cp437(true);
  display.println(F("DCF77 transmitter"));
  display.println(F("v1.0 @2021"));
  display.println();
  display.println(F("A. Velkov"));
  display.display();
  delay(3000);
  drawlogo();
  delay(5000);


  ledcSetup(0, 77500, 8); // DCF77 frequency
  ledcAttachPin(ANTENNAPIN, 0); // Antenna pin

  pinMode (LEDBUILTIN, OUTPUT);
  digitalWrite (LEDBUILTIN, LOW); // LOW if LEDBUILTIN is inverted (like in Wemos boards)

  WiFi_on();
  getNTP();
  WiFi_off();

  CodeTime();

  // sync to the start of a second
  Serial.print("Syncing... ");
   
  int startSecond = timeinfo.tm_sec;
  long count = 0;
  do {
    count++;
    if(!getLocalTime(&timeinfo)){
      Serial.println("Error obtaining time...");
      display.clearDisplay();
      display.setCursor(0, 0);
      display.println(F("Error obtaining time..."));
      display.display();
      delay(3000);
      ESP.restart();
    }
  } while (startSecond == timeinfo.tm_sec);
  
  Serial.print(&timeinfo, "Time now: %B %d %Y %H:%M:%S (%A) %Z ");
  if (timeinfo.tm_isdst == 0) {
    Serial.println("DST=OFF");
  } else {
    Serial.println("DST=ON");
  }
  
  tickerDecisec.attach_ms(100, DcfOut); // from now on calls DcfOut every 100ms
  Serial.print("Ok ");
  Serial.println(count);
  
}

void loop() {
  // There is no code inside the loop. This is a syncronous program driven by the Ticker
}

void CodeTime() {
  DayOfW = timeinfo.tm_wday;
  if (DayOfW == 0) DayOfW = 7;
  actualDay = timeinfo.tm_mday;
  actualMonth = timeinfo.tm_mon + 1;
  actualYear = timeinfo.tm_year - 100;
  actualHours = timeinfo.tm_hour;
  actualMinutes = timeinfo.tm_min + 1; // DCF77 transmitts the next minute
  if (actualMinutes >= 60) {
    actualMinutes = 0;
    actualHours++;
  }
  actualSecond = timeinfo.tm_sec; 
  if (actualSecond == 60) actualSecond = 0;

  int n, Tmp, TmpIn;
  int ParityCount = 0;

  //we put the first 20 bits of each minute at a logical zero value
  for (n = 0; n < 20; n++) impulseArray[n] = 1;
  
  // set DST bit
  if (timeinfo.tm_isdst == 0) {
    impulseArray[18] = 2; // CET or DST OFF
  } else {
    impulseArray[17] = 2; // CEST or DST ON
  }
  
  //bit 20 must be 1 to indicate active time
  impulseArray[20] = 2;

  //calculates the bits for the minutes
  TmpIn = Bin2Bcd(actualMinutes);
  for (n = 21; n < 28; n++) {
    Tmp = TmpIn & 1;
    impulseArray[n] = Tmp + 1;
    ParityCount += Tmp;
    TmpIn >>= 1;
  }
  if ((ParityCount & 1) == 0)
    impulseArray[28] = 1;
  else
    impulseArray[28] = 2;

  //calculates bits for the hours
  ParityCount = 0;
  TmpIn = Bin2Bcd(actualHours);
  for (n = 29; n < 35; n++) {
    Tmp = TmpIn & 1;
    impulseArray[n] = Tmp + 1;
    ParityCount += Tmp;
    TmpIn >>= 1;
  }
  if ((ParityCount & 1) == 0)
    impulseArray[35] = 1;
  else
    impulseArray[35] = 2;
  ParityCount = 0;

  //calculate the bits for the actual Day of Month
  TmpIn = Bin2Bcd(actualDay);
  for (n = 36; n < 42; n++) {
    Tmp = TmpIn & 1;
    impulseArray[n] = Tmp + 1;
    ParityCount += Tmp;
    TmpIn >>= 1;
  }
  TmpIn = Bin2Bcd(DayOfW);
  for (n = 42; n < 45; n++) {
    Tmp = TmpIn & 1;
    impulseArray[n] = Tmp + 1;
    ParityCount += Tmp;
    TmpIn >>= 1;
  }
  //calculates the bits for the actualMonth
  TmpIn = Bin2Bcd(actualMonth);
  for (n = 45; n < 50; n++) {
    Tmp = TmpIn & 1;
    impulseArray[n] = Tmp + 1;
    ParityCount += Tmp;
    TmpIn >>= 1;
  }
  //calculates the bits for actual year
  TmpIn = Bin2Bcd(actualYear);   // 2 digit year
  for (n = 50; n < 58; n++) {
    Tmp = TmpIn & 1;
    impulseArray[n] = Tmp + 1;
    ParityCount += Tmp;
    TmpIn >>= 1;
  }
  //equal date
  if ((ParityCount & 1) == 0)
    impulseArray[58] = 1;
  else
    impulseArray[58] = 2;

  //last missing pulse
  impulseArray[59] = 0; // No pulse
}

int Bin2Bcd(int dato) {
  int msb, lsb;
  if (dato < 10)
    return dato;
  msb = (dato / 10) << 4;
  lsb = dato % 10;
  return msb + lsb;
}

void DcfOut() {
  switch (impulseCount++) {
    case 0:
      if (impulseArray[actualSecond] != 0) {
        digitalWrite(LEDBUILTIN, LOW);
        ledcWrite(0, 0);
      }
      break;
    case 1:
      if (impulseArray[actualSecond] == 1) {
        digitalWrite(LEDBUILTIN, HIGH);
        ledcWrite(0, 127);
      }
      break;
    case 2:
      digitalWrite(LEDBUILTIN, HIGH);
      ledcWrite(0, 127);
      break;
    case 9:
      impulseCount = 0;

      if (actualSecond == 1 || actualSecond == 15 || actualSecond == 21  || actualSecond == 29 ) {
        Serial.print("-");
        time_data+="-";
        show_time(time_data,screensaver,actualSecond);
      }
      if (actualSecond == 36  || actualSecond == 42 || actualSecond == 45  || actualSecond == 50 ) {
        Serial.print("-");
        time_data+="-";
        show_time(time_data,screensaver,actualSecond);
      }
      if (actualSecond == 28  || actualSecond == 35  || actualSecond == 58 ) {
        Serial.print("P");
        time_data+="P";
        show_time(time_data,screensaver,actualSecond);
      }

      if (impulseArray[actualSecond] == 1) {
        Serial.print("0");
        time_data+="0";
        show_time(time_data,screensaver,actualSecond);
      }
      if (impulseArray[actualSecond] == 2) {
        Serial.print("1");
        time_data+="1";
        show_time(time_data,screensaver,actualSecond);
      }

      if (actualSecond == 59 ) {
        Serial.println();
        
        if (screensaver >= 6) {
        screensaver = 1;
        } else screensaver++;
        
        time_data="";
        show_time(time_data,screensaver,actualSecond);

        timeRunningContinuous++;
        if (timeRunningContinuous > 360) ESP.restart(); // 6 hours running, then restart all over

      }
      break;
  }
  if(!getLocalTime(&timeinfo)){
    Serial.println("Error obtaining time...");
    display.clearDisplay();
    display.setCursor(0, 0);
    display.println(F("Error obtaining time..."));
    display.display();
    delay(3000);
    ESP.restart();
  }
  CodeTime();
}

void drawrect(void) {
  display.clearDisplay();

  for(int16_t i=0; i<display.height()/2; i+=2) {
    display.drawRect(i, i, display.width()-2*i, display.height()-2*i, SSD1306_WHITE);
    display.display();
  }
}

void fillrect(void) {
  display.clearDisplay();

  for(int16_t i=0; i<display.height()/2; i+=3) {
    // The INVERSE color is used so rectangles alternate white/black
    display.fillRect(i, i, display.width()-i*2, display.height()-i*2, SSD1306_INVERSE);
    display.display();
  }
}

void drawlogo(void) {
  display.clearDisplay();
  display.drawBitmap(0, 0, logo_bmp, 128, 64, WHITE);
  display.display();
}

void getNTP() {
  Serial.print("GetNTP ");
  display.clearDisplay();
  display.setCursor(0, 0);
  display.println(F("Syncing NTP..."));
  int i = 0;
  do {
    i++;
    if (i > 40) {
      ESP.restart();
    }
    configTime(0, 0, ntpServer);
    setenv("TZ", TZ_INFO, 1);
    delay(500);
  } while (!getLocalTime(&timeinfo));
  Serial.println("Ok");
  display.println();
  display.println(F("Done!"));
  display.display();
  delay(2000);
}

void show_time(String time_data,int screensaver,int actualSecond) {

  if (screensaver==0 || screensaver==2 || screensaver==4 || screensaver==6) {
  display.clearDisplay();
  display.setCursor(0, 48);
  display.println(&timeinfo, "%B %d %Y %Z");
  display.println(&timeinfo, "%H:%M:%S (%A)");
  display.setCursor(0, 0);
  display.println(F("DCF77 realtime data:"));
  display.println();
  display.println(time_data);
  display.display();
  }

  if (screensaver == 1 && actualSecond == 59) drawlogo();
  if (screensaver == 3 && actualSecond == 59) drawrect();
  if (screensaver == 5 && actualSecond == 59) fillrect();
}

void WiFi_on() {
  
  byte mac[6];
  
  Serial.print("Connecting to: "+String(ssid));
  display.clearDisplay();
  display.setCursor(0, 0);
  display.println(F("Connecting WiFi to:"));
  display.println(ssid);
  display.println("...");
  display.display();
  delay(500);
  
  WiFi.begin(ssid, password);
  int counter = 0;
  while (WiFi.status() != WL_CONNECTED) {
    delay(500);
    if (counter > 20) ESP.restart();
    Serial.print ( "." );
    counter++;
  }
  Serial.println();
  Serial.println("WiFi connected");
  display.clearDisplay();
  display.setCursor(0, 0);
  display.println(F("Connecting WiFi to:"));
  display.println(ssid);
  display.println(F("Connected!"));
  display.println();
  display.println(WiFi.localIP());
  display.println();
  WiFi.macAddress(mac);
  display.print(mac[5],HEX);
  display.print(":");
  display.print(mac[4],HEX);
  display.print(":");
  display.print(mac[3],HEX);
  display.print(":");
  display.print(mac[2],HEX);
  display.print(":");
  display.print(mac[1],HEX);
  display.print(":");
  display.println(mac[0],HEX);
  
  display.display();
  delay(5000);
}

void WiFi_off() {
  WiFi.disconnect(true);
  WiFi.mode(WIFI_OFF);
  Serial.println("WiFi disconnected");
  Serial.flush();
}


